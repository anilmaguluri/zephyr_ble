## dts/bindings/video/zephyr,emul-imager.yaml
```yaml
# Copyright 2024 tinyVision.ai Inc.
# SPDX-License-Identifier: Apache-2.0

description: Emulated Imager for testing purpose

compatible: "zephyr,emul-imager"

child-binding:
  child-binding:
    include: video-interfaces.yaml
```

## dts/bindings/video/zephyr,emul-mipi-rx.yaml
```yaml
# Copyright 2024 tinyVision.ai Inc.
# SPDX-License-Identifier: Apache-2.0

description: Emulated Video DMA engine for testing purpose

compatible: "zephyr,emul-mipi-rx"

child-binding:
  child-binding:
    include: video-interfaces.yaml
```
